## base_external/package/aesdchar/Config.in
```kconfig
config BR2_PACKAGE_AESDCHAR
	bool "aesdchar"
	help
	  Includes the aesdchar package which implements a circular buffer using the device /dev/aesdchar
```

## base_external/package/ldd/Config.in
```kconfig
config BR2_PACKAGE_LDD
	bool "ldd"
	help
	  Includes the ldd package which supports building and installing the misc-modules and scull components into the root filesystem.
```
